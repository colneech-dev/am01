## hardware/qmtech-kintex7/buildroot/package/odo-mining-stack/Config.in
```kconfig
config BR2_PACKAGE_ODO_MINING_STACK
	bool "odo-mining-stack"
	depends on BR2_TOOLCHAIN_HAS_THREADS
	select BR2_PACKAGE_LIBGPIOD
	select BR2_PACKAGE_LIBPNG
	select BR2_PACKAGE_FREETYPE
	select BR2_PACKAGE_FONTCONFIG
	help
	  AM01 OdoCrypt mining stack for the Kintex-7 + Raspberry Pi CM4
	  miner: odo-miner (mining daemon), odo-webd (status HTTP server)
	  and odo-ui (framebuffer touch UI).

	  Sources come from this repository plus a sibling checkout of
	  odo-miner-cyclonev.

comment "odo-mining-stack needs a toolchain w/ threads"
	depends on !BR2_TOOLCHAIN_HAS_THREADS
```
