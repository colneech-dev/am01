/*
 * Device-tree overlay for the AM01 FPGA parallel bus on Raspberry Pi CM4.
 *
 * Puts the 24 bus lines into plain GPIO function with pulls disabled at boot,
 * so nothing else has claimed them by the time odo-miner requests them through
 * libgpiod. Per the QMTECH manual section 2.2.9, GPIO0-27 are all routed to the
 * FPGA; this bus uses GPIO0-23:
 *
 *   GPIO0-15   data bus (16 bits)
 *   GPIO16-19  address bus (4 bits)
 *   GPIO20     WR_N  (write strobe, active low)
 *   GPIO21     RD_N  (read strobe, active low)
 *   GPIO22     READY (handshake)
 *   GPIO23     IRQ   (nonce found)
 *
 * Applied by dtoverlay=am01-fpga-gpio in config.txt. config.txt also turns off
 * i2c_arm/spi/i2s, which are the peripherals that would otherwise take these
 * pins, and defines no UART console -- GPIO14/15 are data bits 14/15 here, not
 * TXD/RXD, so the console is a USB gadget on the mini-USB instead.
 *
 * Note the bcm2835 pinctrl binding uses brcm,pins/brcm,function cell lists.
 * A DTS string list is comma-separated; adjacent-string concatenation is C
 * syntax and is a parse error here.
 */

/dts-v1/;
/plugin/;

/ {
	compatible = "brcm,bcm2711";

	fragment@0 {
		target = <&gpio>;
		__overlay__ {
			am01_fpga_pins: am01_fpga_pins {
				brcm,pins = <0 1 2 3 4 5 6 7
					     8 9 10 11 12 13 14 15
					     16 17 18 19 20 21 22 23>;
				brcm,function = <0>;	/* input */
				/* Per-pin pulls, NOT a blanket "none".
				 *
				 * WR_N (20) and RD_N (21) are active-low strobes the CM4
				 * drives. They must idle HIGH. With no pull configured they
				 * fall to the SoC's default pull-DOWN for GPIO9-27, and the
				 * only thing opposing that is the FPGA's weak internal
				 * PULLUP -- so whenever no process holds the lines (before
				 * Linux boots, and between runs of any tool) they drift low.
				 * The FPGA reads that as a permanently asserted strobe,
				 * enters S_WRITE/S_READ, raises READY and stays there.
				 * Measured on hardware: READY read 1 with nothing running,
				 * and every transaction then failed waiting for it to drop.
				 *
				 * 0 = none, 1 = down, 2 = up. Data lines stay pull-none
				 * because they are bidirectional -- a pull would fight the
				 * FPGA when it drives during a read. READY (22) and IRQ (23)
				 * are FPGA outputs and need none either.
				 */
				brcm,pull = <0 0 0 0 0 0 0 0
					     0 0 0 0 0 0 0 0
					     0 0 0 0 2 2 0 0>;
			};
		};
	};

	/* Referencing the node from the gpio controller's own pinctrl-0 is what
	 * actually applies it at probe. The pin group alone is inert. */
	fragment@1 {
		target = <&gpio>;
		__overlay__ {
			pinctrl-names = "default";
			pinctrl-0 = <&am01_fpga_pins>;
		};
	};
};
