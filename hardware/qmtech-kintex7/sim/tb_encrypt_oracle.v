`timescale 1ns/1ps
//
// Does encrypt.v compute what the SOFTWARE ORACLE computes?
//
// WHY THIS DID NOT EXIST, AND WHY THAT MATTERED
// ---------------------------------------------
// Every other testbench in this directory compares RTL against RTL:
//
//   tb_encrypt_equiv   stock core  vs  shared-BRAM rewrite
//   tb_sched_equiv     2-cycle core vs 3-cycle --bram-out-reg core
//   tb_sbox_mux2       sbox         vs  time-multiplexed sbox
//
// Each is a good test of the thing it checks, and all of them are blind to the
// same class of fault: a bug present in BOTH cores. If odo_gen emits a wrong
// round-key schedule, it emits it consistently, every core agrees with every
// other core, and every one of those testbenches passes.
//
// That is not hypothetical. On 2026-08-30 am01_smoke run on real hardware
// showed the FPGA and the software oracle disagreeing on every nonce, with a
// fixed header and no pool, so staleness was impossible by construction. The
// simulation suite had nothing to say about it, because nothing in it ever
// compared against software.
//
// This closes that hole with the cheapest possible test: one known plaintext,
// one known ciphertext, both produced by hps/odocrypt_state.c -- the same
// oracle am01_smoke and odo-miner validate against.
//
// The vector is generated by tools/gen_encrypt_vector.c and pasted below,
// rather than read at runtime, so the test is self-contained and a missing
// file cannot turn into a silent pass.
//
// LATENCY. encrypt_4encrypt registers `in` for two cycles before the loop sees
// it (progress[0], progress[1]), and encrypt_4encrypt_loop asserts `write` from
// the LAST progress stage -- progress[171] on a 2-cycle core, progress[258] on
// the --bram-out-reg 3-cycle core that ships today, whose result lands at cycle
// 265. This waits for
// `write` rather than counting, and fails on timeout instead of comparing
// against X -- an all-X output compared against a real vector must read as a
// FAIL, never as "no mismatch seen".

module tb_encrypt_oracle;

    // ---- vector, from the software oracle at epoch 1788480000 -------------
    // Regenerate with:  tools/gen_encrypt_vector 1788480000
    //
    // MUST be regenerated every epoch, i.e. every 10 days. A vector from the
    // wrong epoch fails for a reason that has nothing to do with correctness,
    // and that is exactly what happened here: this test sat failing against an
    // epoch-1787616000 vector while the shipped core was 1788480000, so
    // nothing could be read from it either way. The generator it names did not
    // exist in the tree until 2026-09-07, so it could not be refreshed.
    localparam [639:0] VEC_IN  = 640'h00000000b16a45338345e0bfeaf7c2a05a432f210e50525619f8ea60e031a5b81235dd2e7e1ebb795f0ef696012ab25cccfc28e42cfc30cacd56cf5b2e32522f8513b1c66d0c322fdfe388ca6969f7a5;
    localparam [639:0] VEC_OUT = 640'h99ed4e7cd8812ba809339c66d852e544bfb147935110bb833f6e458f1ee5dc92a1f3b9091c692da0d56246dfebaa46858b97df8884a492c21aed83274e279fb30e5d394d1696d7c4d0bf581f4453af46;

    reg clk = 1'b0;
    always #5 clk = ~clk;          // 100 MHz, arbitrary -- this is functional

    reg           read = 1'b0;
    reg  [639:0]  din  = 640'h0;
    wire [639:0]  dout;
    wire          write;

    encrypt_4encrypt dut (.clk(clk), .in(din), .read(read), .out(dout), .write(write));

    integer cycles   = 0;
    integer seen     = 0;
    integer diffbits = 0;
    integer bi;
    reg     done   = 1'b0;

    // Cycle counter and progress ticker. The ticker matters: this simulates at
    // seconds per cycle, and a run that prints nothing for ten minutes is
    // indistinguishable from one that has hung.
    always @(posedge clk) begin
        cycles <= cycles + 1;
        if (cycles % 25 == 0)
            $display("  [t=%0t] cycle %0d ...", $time, cycles);
    end

    // Capture the FIRST asserted write -- that is our block.
    always @(posedge clk) begin
        if (write && !done) begin
            done <= 1'b1;
            seen <= seen + 1;
            $display("");
            $display("  write asserted at cycle %0d", cycles);
            $display("  expected 640'h%h", VEC_OUT);
            $display("  actual   640'h%h", dout);
            if (dout === VEC_OUT) begin
                $display("");
                $display("  RESULT: PASS -- encrypt.v matches the software oracle.");
                $display("          A wrong hash on hardware is therefore NOT in");
                $display("          this core; look at the wrapper's header/nonce");
                $display("          plumbing or the Keccak stage.");
            end else if (^dout === 1'bx) begin
                $display("");
                $display("  RESULT: FAIL -- output contains X. The pipeline did not");
                $display("          produce a defined result; this is not a value");
                $display("          mismatch, it is a core that did not run.");
            end else begin
                $display("");
                $display("  RESULT: FAIL -- encrypt.v DISAGREES with the oracle.");
                diffbits = 0;
                for (bi = 0; bi < 640; bi = bi + 1)
                    if (dout[bi] !== VEC_OUT[bi]) diffbits = diffbits + 1;
                $display("          differing bits: %0d of 640", diffbits);
                $display("          The generated core is wrong. Check the round-key");
                $display("          tap against extra_delay in tools/odo_gen.");
            end
            $finish;
        end
    end

    initial begin
        $display("tb_encrypt_oracle: encrypt.v vs the SOFTWARE oracle");
        $display("  (every other testbench here compares RTL against RTL,");
        $display("   which cannot see a fault that is present in both)");
        $display("");

        // Let the initial blocks settle, then present one block for one cycle.
        repeat (4) @(posedge clk);
        din  <= VEC_IN;
        read <= 1'b1;
        @(posedge clk);
        read <= 1'b0;
        $display("  block presented, waiting for write (~265 cycles on");
        $display("  the --bram-out-reg core, ~174 on a 2-cycle one)");

        // Generous ceiling: the pipeline is 259 deep on the shipping core, but a
        // run that never asserts write must end as a FAIL, not hang.
        repeat (600) @(posedge clk);
        if (!done) begin
            $display("");
            $display("  RESULT: FAIL -- write never asserted within 600 cycles.");
            $display("          The core produced no output at all.");
        end
        $finish;
    end

endmodule
