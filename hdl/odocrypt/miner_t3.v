// Copyright (C) 2019 MentalCollatz
// Copyright (C) 2019-2022 AtomMiner LLC
//
// This program is free software: you can redistribute it and/or modify
// it under the terms of the GNU General Public License as published by
// the Free Software Foundation, either version 3 of the License, or
// (at your option) any later version.
//
// This program is distributed in the hope that it will be useful,
// but WITHOUT ANY WARRANTY; without even the implied warranty of
// MERCHANTABILITY or FITNESS FOR A PARTICULAR PURPOSE.  See the
// GNU General Public License for more details.
//
// You should have received a copy of the GNU General Public License
// along with this program.  If not, see <http://www.gnu.org/licenses/>.
`timescale 1ns / 1ps
//
// THROUGHPUT=3 variant of miner.v (RESULTS.md "THROUGHPUT is discretized"
// table). 1.33x the parallel round logic (unrolling 21 -> 28) against a
// matching `encrypt_3encrypt` core generated by
// `odo_gen <epoch> 3 encrypt_3 --bram-out-reg`.
//
// Unlike miner_t2.v this needs NO --lutram: BRAM lands at 560/890 (63%),
// the same safe occupancy every other single-miner build in this project
// has routed at, no LUTRAM conversion required.
//
// A separate file rather than editing miner.v in place: miner.v is a pinned
// third-party core (rtl_sources.sh), and THROUGHPUT/the encrypt module name
// are compiled-in, not parameters -- there is no way to make one file serve
// both configurations without a macro-driven module name, which is a larger
// and riskier change than duplicating ~160 lines. Module names (miner,
// miner_top, odo_keccak, cmp_256) are UNCHANGED from miner.v, so this file
// must never be compiled alongside miner.v in the same build -- doing so
// would double-define every module in it. That failure mode is loud
// (duplicate-module error), not silent.
//
// Everything below this comment is otherwise IDENTICAL to miner.v except the
// two lines marked CHANGED.

`define  THROUGHPUT 3 // CHANGED: was 4

module cmp_256(clk, in, read, target, out, write);
	input clk;
	input [255:0] in;
	input read;
	input [255:0] target;
	output reg out = 1'b0;
	output reg write;

	reg [15:0] greater = 16'h0, less = 16'h0;
	reg progress;
									reg read_r = 1'b0;
	initial progress = 0;
	initial write = 0;

	genvar i;
	generate
	for (i = 0; i < 16; i = i+1)
	begin : loop
		always @(posedge clk)
		begin
			greater[i] <= (in[16*i+15:16*i] > target[16*i+15:16*i]);
			less[i] <= (in[16*i+15:16*i] < target[16*i+15:16*i]);
		end
	end
	endgenerate

	always @(posedge clk) read_r <= read;
	always @(posedge clk) if (read_r)  out <= (greater < less); else out <= 1'b0;

	always @(posedge clk)
	begin
		progress <= read;
		write <= progress;
	end
endmodule

module odo_keccak(clk, in, read, target, out, write);
	input clk;
	input [639:0] in;
	input read;
	input [255:0] target;
	output out; //ticket2moon
	output write;

	wire [639:0] midstate;
	wire midread;
	wire [255:0] pow_hash;
	wire has_hash;

	encrypt_3encrypt crypt(clk, in, read, midstate, midread); // CHANGED: was encrypt_4encrypt
	keccak_hasher #(640, `THROUGHPUT) hash(clk, midstate, midread, pow_hash, has_hash);
	cmp_256 compare(clk, pow_hash, has_hash, target, out, write);
endmodule

module miner(clk, header, target, start_hash, res, nonce);
	// NONCE_BASE lets several miner instances share one work item by
	// each sweeping a different slice of the 32-bit nonce space. Default
	// 0 reproduces the original single-instance behaviour exactly, so
	// existing instantiations (atomminer_odocrypt.v) are unaffected.
	parameter [31:0] NONCE_BASE = 32'h0;

	input clk;
	input [607:0] header;
	input [255:0] target;
	input start_hash;
	output wire res;
	output reg [31:0] nonce;

	reg [31:0] nonce_in = NONCE_BASE;
	reg [31:0] nonce_out = NONCE_BASE;

	reg [6:0] counter;
	reg advance;
	initial counter = `THROUGHPUT-1;
	initial advance = 0;

	wire has_res;
	reg [5:0] cou_deltanonce = 6'b0;
	reg nonce_out_go = 1'b0;

	odo_keccak worker(clk, {nonce_in, header}, advance, target, res, has_res);

	always @(posedge clk)
	begin
		if (~start_hash)
		begin
			counter <= 0;
			advance <= 1'b0;
		end
		else if (counter == `THROUGHPUT-1 & start_hash)
		begin
			counter <= 0;
			advance <= 1;
		end
		else
		begin
			counter <= counter + 1;
			advance <= 0;
		end
		if (~start_hash)
			nonce_in <= NONCE_BASE;
		else if (advance & start_hash)
			nonce_in <= nonce_in + 1;
		if (~start_hash)
			nonce_out <= NONCE_BASE;
		// nonce_out counts EVERY result, gate or no gate.
		//
		// It used to increment only under nonce_out_go, so every result
		// emerging before the 204-cycle warm-up went uncounted and this
		// counter permanently lost sync with the result stream. The nonce
		// reported for a solution was then wrong by however many results
		// had been skipped -- measured on hardware 2026-08-30 as +16 on one
		// run and -112 on another, i.e. not a fixed offset but a function of
		// where in the drain the gate happened to open.
		//
		// odo-miner-cyclonev's working core (odo_miner_core.v) has no gate on
		// the counter at all: nonce_in and nonce_out free-run from reset, so
		// the Nth result pairs with the Nth input by construction. That is the
		// invariant, and gating the counter is what broke it.
		//
		// The warm-up still suppresses REPORTING, which is all it was ever
		// for: stale old-header results must not be published as solutions.
		else if (has_res & start_hash)
		begin
			if (res & nonce_out_go) nonce <= nonce_out;
			nonce_out <= nonce_out + 1;
		end
	end

always @ (posedge clk)
	if (~start_hash)   cou_deltanonce <= 6'b0;
	else if (advance)  cou_deltanonce <= cou_deltanonce + 1'b1;

always @ (posedge clk)
	if (~start_hash) nonce_out_go <= 1'b0;
	else if ( cou_deltanonce == 6'h33)  nonce_out_go <= 1'b1;

endmodule

module miner_top(osc_clk, header, target, start_hash, ticket2moon, nonce);
	// See miner's NONCE_BASE -- defaulted, so existing users are unchanged.
	parameter [31:0] NONCE_BASE = 32'h0;

	input osc_clk;
	input [607:0] header;
	input [255:0] target;
	input start_hash;

	output ticket2moon;
	output [31:0] nonce;

	wire miner_clk;
	wire res;
	assign miner_clk = osc_clk;

	miner #(.NONCE_BASE(NONCE_BASE)) miner (miner_clk, header, target, start_hash, res, nonce);

	assign ticket2moon = res;

endmodule

